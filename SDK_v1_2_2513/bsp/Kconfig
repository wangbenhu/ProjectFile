## SDK_v1_2_2513/bsp/Kconfig
```kconfig
menu "BSP"

choice
    prompt "Board Select"
    default BOARD_NONE

config BOARD_NONE
    bool "Non-specific board"
config BOARD_EVB
    bool "Evaluation board"
endchoice

choice
    prompt "Graphics LCD controller"
    default GLCD_NONE
    depends on BOARD_EVB

config GLCD_NONE
    bool "Non-specific GLCD"
config GLCD_GC9C01
    bool "Graphics LCD GC9C01"
config GLCD_ST7796
    bool "Graphics LCD ST7796"
config GLCD_ST7789
    bool "Graphics LCD ST7789"
endchoice

endmenu
```
