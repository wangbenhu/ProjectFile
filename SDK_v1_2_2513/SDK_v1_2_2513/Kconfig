## SDK_v1_2_2513/SDK_v1_2_2513/Kconfig
```kconfig
################################################################################
## @File       Kconfig
## @Brief      SDK configuration
################################################################################

mainmenu "SDK Configuration"


#
# System
#
menu 'System'
config TOOL_CHAIN_OPTIMIZATION_LEVEL
    int "Optimization Level(0:-O0, 1:-O1, 2:-O2, 3:-O3, 4:-Os, 5:-Of, 6:-Og)"
    range 0 6
    default 4

endmenu

#
# BSP
#
rsource "bsp/Kconfig"

#
# components
#
rsource "components/Kconfig"

#
# hal
#
rsource "hal/Kconfig"

#
# RTOS
#
rsource "rtos/Kconfig"
```

## SDK_v1_2_2513/components/CherryUSB/Kconfig
```kconfig
# Kconfig file for CherryUSB
menuconfig CHERRYUSB
    bool "CherryUSB Configuration"
    default n

if CHERRYUSB

    choice
        prompt "OSAL Select"
        default CHERRYUSB_OSAL_FREERTOS
        config CHERRYUSB_OSAL_NONE
            bool "NONE"
        config CHERRYUSB_OSAL_FREERTOS
            bool "FreeRTOS"
    endchoice

    menuconfig CHERRYUSB_DEVICE
        bool "Enable usb device mode"
        default y

    if CHERRYUSB_DEVICE
        choice
            prompt "Select usb device speed"
            default CHERRYUSB_DEVICE_SPEED_FS
            config CHERRYUSB_DEVICE_SPEED_FS
                bool "FS"
            config CHERRYUSB_DEVICE_SPEED_HS
                bool "HS"
            config CHERRYUSB_DEVICE_SPEED_AUTO
                bool "AUTO"
        endchoice

        choice
            prompt "Select usb device ip, and some ip need config in usb_config.h, please check"
            default CHERRYUSB_DEVICE_MUSB_OM
            config CHERRYUSB_DEVICE_DWC2_OM
                bool "dwc2_om"
            config CHERRYUSB_DEVICE_MUSB_OM
                bool "musb_om"
        endchoice

        config CHERRYUSB_DEVICE_CDC_ACM
            bool
            prompt "Enable usb cdc acm device"
            default y

        config CHERRYUSB_DEVICE_HID
            bool
            prompt "Enable usb hid device"
            default y

        config CHERRYUSB_DEVICE_MSC
            bool
            prompt "Enable usb msc device"
            default y

        config CHERRYUSB_DEVICE_AUDIO
            bool
            prompt "Enable usb audio device"
            default y

        config CHERRYUSB_DEVICE_VIDEO
            bool
            prompt "Enable usb video device"
            default n

        config CHERRYUSB_DEVICE_CDC_RNDIS
            bool
            prompt "Enable usb cdc rndis device"
            default n

        config CHERRYUSB_DEVICE_CDC_ECM
            bool
            prompt "Enable usb cdc ecm device"
            default n

        config CHERRYUSB_DEVICE_CDC_NCM
            bool
            prompt "Enable usb cdc ncm device"
            default n

        config CHERRYUSB_DEVICE_DFU
            bool
            prompt "Enable usb dfu device"
            default n

        config CHERRYUSB_DEVICE_ADB
            bool
            prompt "Enable usb adb device"
            default n

        choice
            prompt "Select usb device template"
            default CHERRYUSB_DEVICE_TEMPLATE_NONE
            config CHERRYUSB_DEVICE_TEMPLATE_NONE
                bool "none (Implement it yourself)"
            config CHERRYUSB_DEVICE_TEMPLATE_CDC_ACM
                bool "cdc_acm"
            config CHERRYUSB_DEVICE_TEMPLATE_MSC
                bool "msc"
            config CHERRYUSB_DEVICE_TEMPLATE_HID_KEYBOARD
                bool "hid_keyboard"
            config CHERRYUSB_DEVICE_TEMPLATE_HID_MOUSE
                bool "hid_mouse"
            config CHERRYUSB_DEVICE_TEMPLATE_HID_CUSTOM
                bool "hid_custom"
            config CHERRYUSB_DEVICE_TEMPLATE_VIDEO
                bool "video"
            config CHERRYUSB_DEVICE_TEMPLATE_AUDIO_V1_MIC_SPEAKER
                bool "audio_v1_mic_speaker_multichan"
            config CHERRYUSB_DEVICE_TEMPLATE_AUDIO_V2_MIC_SPEAKER
                bool "audio_v2_mic_speaker_multichan"
            config CHERRYUSB_DEVICE_TEMPLATE_CDC_RNDIS
                bool "cdc_rndis"
            config CHERRYUSB_DEVICE_TEMPLATE_CDC_ECM
                bool "cdc_ecm"
            config CHERRYUSB_DEVICE_TEMPLATE_CDC_NCM
                bool "cdc_ncm"
            config CHERRYUSB_DEVICE_TEMPLATE_CDC_ACM_MSC
                bool "cdc_acm_msc"
            config CHERRYUSB_DEVICE_TEMPLATE_CDC_ACM_MSC_HID
                bool "cdc_acm_msc_hid"
            config CHERRYUSB_DEVICE_TEMPLATE_WINUSBV1
                bool "winusbv1"
            config CHERRYUSB_DEVICE_TEMPLATE_WINUSBV2_CDC
                bool "winusbv2_cdc"
            config CHERRYUSB_DEVICE_TEMPLATE_WINUSBV2_HID
                bool "winusbv2_hid"
        endchoice

    endif

    menuconfig CHERRYUSB_HOST
        bool "Enable usb host mode"
        default n

    if CHERRYUSB_HOST
        choice
            prompt "Select usb host ip, and some ip need config in usb_config.h, please check"
            default CHERRYUSB_HOST_MUSB_OM
            config CHERRYUSB_HOST_DWC2_OM
                bool "dwc2_om"
            config CHERRYUSB_HOST_MUSB_OM
                bool "musb_om"
        endchoice

        config CHERRYUSB_HOST_CDC_ACM
            bool
            prompt "Enable usb cdc acm driver"
            default n

        config CHERRYUSB_HOST_HID
            bool
            prompt "Enable usb hid driver"
            default n

        config CHERRYUSB_HOST_MSC
            bool
            prompt "Enable usb msc driver"
            default n

        config CHERRYUSB_HOST_CDC_ECM
            bool
            prompt "Enable usb cdc ecm driver"
            select USBHOST_PLATFORM_CDC_ECM
            default n

        config CHERRYUSB_HOST_CDC_RNDIS
            bool
            prompt "Enable usb rndis driver"
            select USBHOST_PLATFORM_CDC_RNDIS
            default n

        config CHERRYUSB_HOST_CDC_NCM
            bool
            prompt "Enable usb cdc ncm driver"
            select USBHOST_PLATFORM_CDC_NCM
            default n

        config CHERRYUSB_HOST_VIDEO
            bool
            prompt "Enable usb video driver, it is commercial charge"
            default n

        config CHERRYUSB_HOST_AUDIO
            bool
            prompt "Enable usb audio driver, it is commercial charge"
            default n

        config CHERRYUSB_HOST_BLUETOOTH
            bool
            prompt "Enable usb bluetooth driver"
            default n

        config CHERRYUSB_HOST_ASIX
            bool
            prompt "Enable usb asix driver"
            select USBHOST_PLATFORM_ASIX
            default n

        config CHERRYUSB_HOST_RTL8152
            bool
            prompt "Enable usb rtl8152 driver"
            select USBHOST_PLATFORM_RTL8152
            default n

        config CHERRYUSB_HOST_FTDI
            bool
            prompt "Enable usb ftdi driver"
            default n

        config CHERRYUSB_HOST_CH34X
            bool
            prompt "Enable usb ch34x driver"
            default n

        config CHERRYUSB_HOST_CP210X
            bool
            prompt "Enable usb cp210x driver"
            default n

        config CHERRYUSB_HOST_PL2303
            bool
            prompt "Enable usb pl2303 driver"
            default n

        config USBHOST_PLATFORM_CDC_ECM
            bool

        config USBHOST_PLATFORM_CDC_RNDIS
            bool

        config USBHOST_PLATFORM_CDC_NCM
            bool

        config USBHOST_PLATFORM_ASIX
            bool

        config USBHOST_PLATFORM_RTL8152
            bool

        config CHERRYUSB_HOST_TEMPLATE
            bool
            prompt "Use usb host template"
            default n

        if CHERRYUSB_HOST_TEMPLATE
            config TEST_USBH_CDC_ACM
                int
                prompt "demo for test cdc acm"
                default 0
                depends on CHERRYUSB_HOST_CDC_ACM
            config TEST_USBH_HID
                int
                prompt "demo for test hid"
                default 0
                depends on CHERRYUSB_HOST_HID
            config TEST_USBH_MSC
                int
                prompt "demo for test msc"
                default 0
                depends on CHERRYUSB_HOST_MSC
        endif
    endif

endif
```

## SDK_v1_2_2513/components/ble/controller/Kconfig
```kconfig
# Kconfig file for CherryUSB
menuconfig BLE_CONTROLLER
    bool "BLE controller stack"
    default y

if BLE_CONTROLLER
    choice
        prompt "library"
        default BLE_CONTROLLER_LIB_FULL
    config BLE_CONTROLLER_LIB_1PERIPHERAL
        bool "Only 1 BLE Peripheral"
    config BLE_CONTROLLER_LIB_FULL
        bool "Full BLE Function, support no more than 8 connections"
    config BLE_CONTROLLER_LIB_FULL_PLUS
        bool "Full BLE Function, support more than 8 connections"
    config BLE_CONTROLLER_LIB_VELA_MESH
        bool "For Vela Mesh Zephyr Host"
    endchoice
endif
```

## SDK_v1_2_2513/components/manu_system/Kconfig
```kconfig
config FAULT_HANDLE
    bool "fault handle enable"
    default y

config MANU_CALIB
    bool "enable calibration via proprietary 2.4GHqz​"
    default n

config MANU_CALIB_BLE_V2
    bool "enable calibration via ble v2"
    default n
```

## SDK_v1_2_2513/components/pm/Kconfig
```kconfig
config PM
    bool "Power Manager"
    default y

if PM
config PM_CHECKER_NUM
    int "Num of checker before sleep"
    default 4
config PM_STORE_CALLBACK_NUM
    int "Num of store callbacks before sleep"
    default 6
endif
```

## SDK_v1_2_2513/components/shell/Kconfig
```kconfig
menuconfig SHELL
    bool "Shell terminal"
    default y

if SHELL
    config SHELL_STACK_SIZE
        depends on !NON_RTOS
        int "shell stack size (unit: Bytes)"
        default 4096

    config SHELL_UART_IDX
        int "shell retarget UART index"
        range 0 3
        default 1

    config SHELL_BAUDRATE
        int "UART baudrate"
        default 115200
endif
```

## SDK_v1_2_2513/hal/Kconfig
```kconfig
menu 'Hal'

config CMSIS_DSP
    bool "CMSIS DSP"
    default n

config CMSIS_NN
    bool "CMSIS NN"
    default n

endmenu
```

## SDK_v1_2_2513/projects/rf_calibration_dongle_v2/Kconfig
```kconfig
# source SDK Kconfig
source "$(SDK_DIR)/Kconfig"

menu "Project"

choice
    prompt "Code Execute in place"
    default XIP_FLASH
config XIP_RAM
    bool "RAM"
config XIP_FLASH
    bool "FLASH"
config XIP_ROM
    bool "ROM"
endchoice

config OM_ASSERT
    bool "Enable assert check"
    default y

orsource "*/Kconfig"
endmenu
```

## SDK_v1_2_2513/projects/usbd_cdc_acm/Kconfig
```kconfig
# source SDK Kconfig
source "$(SDK_DIR)/Kconfig"

menu "Project"

config OM_ASSERT
    bool "Enable assert check"
    default y

orsource "*/Kconfig"
endmenu
```

## SDK_v1_2_2513/rtos/Kconfig
```kconfig
menu "RTOS"
choice
    prompt "RTOS selection"
    default NON_RTOS

#
# NON_RTOS
#
config NON_RTOS
    bool "non-RTOS"

#
# FreeRTOS
#
orsource "FreeRTOS/Kconfig"

endchoice

endmenu
```

## SDK_v1_2_2564/components/ble/Kconfig
```kconfig
menuconfig BLE
    bool "Bluetooth Low Energy Stack"
    select EVT
    select NVDS
    select PM
    default y

if BLE
    config BLE_MESH
        bool "BLE Mesh"
        depends on BLE_CONTROLLER
        depends on BLE_HOST
        depends on FREE_RTOS
        default n
    orsource "controller/Kconfig"
    orsource "host/Kconfig"

endif
```

## SDK_v1_2_2564/components/ble/host/Kconfig
```kconfig
# Kconfig file for BLE controller
menuconfig BLE_HOST
    bool "BLE Host stack"
    default y
    config BLE_PROFILE
        bool "BLE profile"
        depends on BLE_HOST
        default y


if BLE_HOST
    config LE_LL_SEC_CON
        bool "LE Link Layer Security Connection"
        default n
    config LE_HOST_ATT_MTU
        int "LE Host ATT MTU"
        default 247
    config LE_HOST_ATT_WRITE_CACHE_SIZE
        int "LE Host ATT Write Cache Size"
        default 23
    config LE_HOST_MAX_GATT_SERV_NUM
        int "LE Host Max GATT Service Number"
        default 8
    config LE_HOST_SC_PAIRING
        bool "LE Host Secure Connections Pairing"
        default n
    config LE_HOST_ADV_SET_NUM
        int "LE Host Advertising Set Number"
        default 4
    config LE_HOST_CONNECTION_NB
        int "LE Host Connection Number"
        default 8
    config LE_HOST_MSG_SIZE
        int "LE Host Message Size"
        default 512
endif
```

## SDK_v1_2_2564/components/om_log/Kconfig
```kconfig
menuconfig OM_LOG
    bool "log"
    default n

if OM_LOG
    choice
        prompt "log retarget"
        default OM_LOG_TO_SHELL

        config OM_LOG_TO_SHELL
            bool "shell"
            select SHELL
        config OM_LOG_TO_RTT
            bool "rtt"
            select SEGGER_RTT
        config OM_LOG_TO_UART
            bool "uart"
        config OM_LOG_TO_FLASH
            bool "flash"
    endchoice

    if OM_LOG_TO_UART
        config OM_LOG_UART_IDX
            int "uart index"
            default 1
        config OM_LOG_UART_BAUDRATE
            int "uart baudrate"
            default 115200
    endif

    if OM_LOG_TO_FLASH
        choice
            prompt "flash type"
            default OM_LOG_FLASH_INTERNAL

            config OM_LOG_FLASH_INTERNAL
                bool "iflash"
            config OM_LOG_FLASH_EXTERNAL
                bool "oflash"
        endchoice
        config OM_LOG_FLASH_ADDR
            hex "flash address to save log(4K aligned)"
            default 0xFF000
        config OM_LOG_SAVE_SIZE
            int "flash and ram area size for log saving"
            default 1024
    endif

    config OM_LOG_TIME
        bool "log time output enable"
        default n
    config OM_LOG_FILTER_LEVEL
        int "log filter level(0:assert 1:error 2:warn 3:info 4:debug 5:none)"
        range 0 5
        default 5
    config OM_LOG_LINE_MAX
        int "log line maximum length"
        default 256
endif
```

## SDK_v1_2_2564/components/trace/Kconfig
```kconfig
config TRACE
    bool "Trace enable"
    default n
if TRACE
    config TRACE_IO_EVENT_NUM
    int "maximum trace io number"
    default 4
endif
```

## SDK_v1_2_2564/projects/example/Kconfig
```kconfig
# source SDK Kconfig
source "$(SDK_DIR)/Kconfig"

menu "Project"

choice
    prompt "Code Execute in place"
    default XIP_FLASH
config XIP_RAM
    bool "RAM"
config XIP_FLASH
    bool "FLASH"
config XIP_ROM
    bool "ROM"
endchoice

config OM_ASSERT
    bool "Enable assert check"
    default y

config MEM_NUM
    int "Number of Heap Region"
    default 1

orsource "*/Kconfig"
endmenu
```
